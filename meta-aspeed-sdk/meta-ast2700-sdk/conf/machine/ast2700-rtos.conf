## meta-aspeed-sdk/meta-ast2700-sdk/conf/machine/ast2700-ufs.conf
```bitbake
require conf/machine/include/ast2700-sdk.inc
require conf/machine/include/ast-ssp.inc
require conf/machine/include/ast-tsp.inc
require conf/machine/include/ast-ufs.inc
require conf/machine/include/ast2700-secure-customize-gen.inc
require conf/distro/include/phosphor-mmc.inc
require conf/machine/include/obmc-bsp-common.inc

# UFS Partition Layout File
WKS_FILE = "ast2700-ufs.wks.in"
WIC_SECTOR_SIZE = "4096"
WIC_BLOCK_SIZE = "4096"

# CALIPTRA Settings
CALIPTRA_FW_BINARY = "ast2700-caliptra-fw-v1.2.bin"

# BootMCU Build Settings
BOOTMCU_FW_BINARY = "ast2700-mcu-runtime.bin"

# U-Boot Build Settings
UBOOT_MACHINE = "evb-ast2700_defconfig"
UBOOT_DEVICETREE = "ast2700-evb"

# Kernel Build Settings
KERNEL_DEVICETREE = "aspeed/ast2700-evb.dtb"
KBUILD_DEFCONFIG = "aspeed_g7_defconfig"

# MMC u-boot and kernel partition size
# Boot area has 4MB,
# so caliptra, bootmuc and bootloader-fit has 4096kb.
FLASH_CALIPTRA_SIZE = "128"
FLASH_BMCU_SIZE = "896"
MMC_UBOOT_SIZE = "4096"
MMC_BOOT_PARTITION_SIZE = "24576"

MACHINE_FEATURES += "\
        obmc-phosphor-fan-mgmt \
        obmc-phosphor-chassis-mgmt \
        obmc-phosphor-flash-mgmt \
        obmc-host-ipmi \
        obmc-host-state-mgmt \
        obmc-chassis-state-mgmt \
        obmc-bmc-state-mgmt \
        "

PREFERRED_PROVIDER_virtual/obmc-system-mgmt = "packagegroup-aspeed-obmc"
PREFERRED_PROVIDER_virtual/obmc-host-ipmi-hw = "phosphor-ipmi-kcs"
VIRTUAL-RUNTIME_obmc-host-state-manager ?= "x86-power-control"
VIRTUAL-RUNTIME_obmc-chassis-state-manager ?= "x86-power-control"

EXTRA_IMAGEDEPENDS:append = " \
    aspeed-image-recoveryuart \
    "
```

## meta-aspeed-sdk/meta-ast2700-sdk/conf/machine/ast2705-a0-default-ncsi.conf
```bitbake
require conf/machine/ast2705-a0-default.conf

# U-Boot Build Settings
UBOOT_DEVICETREE = "ast2705-ncsi"

# Kernel Build Settings
KERNEL_DEVICETREE = "aspeed/ast2705-ncsi.dtb"
```

## meta-aspeed-sdk/meta-ast2700-sdk/conf/machine/ast2705-a0-default.conf
```bitbake
require conf/machine/include/ast2705-sdk.inc
require conf/machine/include/ast-ssp.inc
require conf/machine/include/ast-tsp.inc
require conf/machine/include/obmc-bsp-common.inc

# Overwrite flash layout
FLASH_SIZE = "131072"
FLASH_SSMCU_ROM_SIZE:flash-131072 = "512"
FLASH_ABB_OFFSET:flash-131072 = "1024"
FLASH_UBOOT_OFFSET:flash-131072 = "0"
FLASH_UBOOT_ENV_OFFSET:flash-131072 = "4096"
FLASH_KERNEL_OFFSET:flash-131072 = "4224"
FLASH_ROFS_OFFSET:flash-131072 = "13440"
FLASH_RWFS_OFFSET:flash-131072 = "98304"
RWFS_SIZE = "33554432"

# BMC binary Settings
PREBUILT_DIR = "ast2755a0"
SSMCU_ROM_BINARY = "ssmcu-rom-ast2755-aspeed-xip.bin"
SSMCU_RUNTIME_BINARY = "ssmcu-runtime-ast2755.bin"
BOOTMCU_ROM_BINARY = "ast2755_xip_fpga_rom.bin"
CALIPTRA_FW_BINARY = "caliptra-fw.bin"

# U-Boot Build Settings
UBOOT_MACHINE = "evb-ast2705_defconfig"
UBOOT_DEVICETREE = "ast2705-evb"

# Kernel Build Settings
KERNEL_DEVICETREE = "aspeed/ast2705-evb.dtb"
KBUILD_DEFCONFIG = "aspeed_g7_defconfig"

MACHINE_FEATURES += "\
        obmc-phosphor-fan-mgmt \
        obmc-phosphor-chassis-mgmt \
        obmc-phosphor-flash-mgmt \
        obmc-host-ipmi \
        obmc-host-state-mgmt \
        obmc-chassis-state-mgmt \
        obmc-bmc-state-mgmt \
        "

PREFERRED_PROVIDER_virtual/obmc-system-mgmt = "packagegroup-aspeed-obmc"
PREFERRED_PROVIDER_virtual/obmc-host-ipmi-hw = "phosphor-ipmi-kcs"
VIRTUAL-RUNTIME_obmc-host-state-manager ?= "x86-power-control"
VIRTUAL-RUNTIME_obmc-chassis-state-manager ?= "x86-power-control"
```

## meta-aspeed-sdk/meta-ast2700-sdk/conf/machine/ast2705-a0-ufs.conf
```bitbake
require conf/machine/include/ast2705-sdk.inc
require conf/machine/include/ast-ssp.inc
require conf/machine/include/ast-tsp.inc
require conf/machine/include/ast-ufs.inc
require conf/distro/include/phosphor-mmc.inc
require conf/machine/include/obmc-bsp-common.inc

# UFS Partition Layout File
WKS_FILE = "ast2700-ufs.wks.in"
WIC_SECTOR_SIZE = "4096"
WIC_BLOCK_SIZE = "4096"

# SSMCU ROM / ABB placement in do_merge_uboot.
FLASH_SSMCU_ROM_SIZE = "512"
FLASH_ABB_OFFSET = "1024"

# BMC binary Settings
PREBUILT_DIR = "ast2705a0"
SSMCU_ROM_BINARY = "ssmcu-rom-xip.bin"
SSMCU_RUNTIME_BINARY = "ssmcu-runtime.bin"
BOOTMCU_ROM_BINARY = "bootmcu-rom-xip*.bin"
CALIPTRA_FW_BINARY = "caliptra-fw.bin"

# U-Boot Build Settings
UBOOT_MACHINE = "evb-ast2705_defconfig"
UBOOT_DEVICETREE = "ast2705-evb"

# Kernel Build Settings
KERNEL_DEVICETREE = "aspeed/ast2705-evb.dtb"
KBUILD_DEFCONFIG = "aspeed_g7_defconfig"

# MMC u-boot and kernel partition size
# Boot area has 4MB, so Caliptra Manifest Flash image has 4096kb.
MMC_UBOOT_SIZE = "4096"
MMC_BOOT_PARTITION_SIZE = "24576"

MACHINE_FEATURES += "\
        obmc-phosphor-fan-mgmt \
        obmc-phosphor-chassis-mgmt \
        obmc-phosphor-flash-mgmt \
        obmc-host-ipmi \
        obmc-host-state-mgmt \
        obmc-chassis-state-mgmt \
        obmc-bmc-state-mgmt \
        "

PREFERRED_PROVIDER_virtual/obmc-system-mgmt = "packagegroup-aspeed-obmc"
PREFERRED_PROVIDER_virtual/obmc-host-ipmi-hw = "phosphor-ipmi-kcs"
VIRTUAL-RUNTIME_obmc-host-state-manager ?= "x86-power-control"
VIRTUAL-RUNTIME_obmc-chassis-state-manager ?= "x86-power-control"
```

## meta-aspeed-sdk/meta-vendor/meta-vendor-amd/meta-amd-sp7/conf/machine/ast2700-sp7.conf
```bitbake
require conf/machine/include/ast2700-sdk.inc
require conf/machine/include/ast-ssp.inc
require conf/machine/include/ast-tsp.inc
require conf/machine/include/obmc-bsp-common.inc

# Overwrite flash layout
FLASH_SIZE = "65536"
FLASH_UBOOT_OFFSET:flash-65536 = "0"
FLASH_UBOOT_ENV_OFFSET:flash-65536 = "4096"
FLASH_KERNEL_OFFSET:flash-65536 = "4224"
FLASH_ROFS_OFFSET:flash-65536 = "13440"
FLASH_RWFS_OFFSET:flash-65536 = "50944"

# PFR settings
PFR_IMAGE_SIZE = "262144"
# 0x3F00000
PFM_OFFSET_PAGE = "64512"
# 0x04000000
RC_IMAGE_PAGE = "65536"
DUAL_FLASH = "1"
FIRST_FLASH_SIZE = "131072"

# CALIPTRA Settings
# AST2700 mcu-runtime bundle build without Caliptra
CPTRA_TOML_ECC_ENABLE = "0"
CPTRA_TOML_LMS_ENABLE = "0"
CPTRA_TOML_ZERO_CALIPTRA_FILE_END = "0x20000"
CPTRA_TOML_IMG_MCU = ""

# BootMCU Build Settings
BOOTMCU_FW_BINARY = "ast2700-mcu-runtime.bin"

# U-Boot Build Settings
UBOOT_MACHINE = "evb-ast2700_defconfig"
UBOOT_DEVICETREE = "ast2700-dcscm"

# Kernel Build Settings
KERNEL_DEVICETREE = "aspeed/aspeed-bmc-amd-kenya.dtb \
                     aspeed/ast2700-dcscm-amd.dtb \
                     "
KBUILD_DEFCONFIG = "aspeed_g7_defconfig"

MACHINE_FEATURES += "\
        obmc-phosphor-fan-mgmt \
        obmc-phosphor-chassis-mgmt \
        obmc-phosphor-flash-mgmt \
        obmc-host-ipmi \
        obmc-host-state-mgmt \
        obmc-chassis-state-mgmt \
        obmc-bmc-state-mgmt \
        "

PREFERRED_PROVIDER_virtual/obmc-system-mgmt = "packagegroup-aspeed-obmc"
PREFERRED_PROVIDER_virtual/obmc-host-ipmi-hw = "phosphor-ipmi-kcs"
VIRTUAL-RUNTIME_obmc-host-state-manager ?= "x86-power-control"
VIRTUAL-RUNTIME_obmc-chassis-state-manager ?= "x86-power-control"

EXTRA_IMAGEDEPENDS:append = " \
    aspeed-image-recoveryuart \
    "
```
