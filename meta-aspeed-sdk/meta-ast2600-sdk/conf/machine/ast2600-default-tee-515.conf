## meta-aspeed-sdk/meta-ast2600-sdk/conf/machine/ast2600-default-tee-515.conf
```bitbake
require conf/machine/ast2600-default-tee.conf

# Kernel Build Settings
KERNEL_DEVICETREE = "aspeed-ast2600-evb-tee.dtb"

PREFERRED_VERSION_linux-aspeed = "5.15+%"
```

## meta-aspeed-sdk/meta-ast2600-sdk/conf/machine/ast2600-default-tee-612.conf
```bitbake
require conf/machine/ast2600-default-tee.conf

PREFERRED_VERSION_linux-aspeed = "6.12+%"
```

## meta-aspeed-sdk/meta-ast2600-sdk/conf/machine/ast2600-default.conf
```bitbake
require conf/machine/include/ast2600-sdk.inc
require conf/machine/include/ast-ssp.inc
require conf/machine/include/aspeed-tpm2.inc
require conf/machine/include/ast2600-secure-customize-gen.inc
require conf/machine/include/obmc-bsp-common.inc

# Overwrite flash layout
FLASH_SIZE = "65536"
FLASH_UBOOT_SPL_SIZE:flash-65536 = "64"
FLASH_UBOOT_OFFSET:flash-65536 = "0"
FLASH_UBOOT_ENV_OFFSET:flash-65536 = "1280"
FLASH_KERNEL_OFFSET:flash-65536 = "1408"
FLASH_ROFS_OFFSET:flash-65536 = "9600"
FLASH_RWFS_OFFSET:flash-65536 = "47104"
RWFS_SIZE = "18874368"

# U-Boot Build Settings
UBOOT_MACHINE = "evb-ast2600_defconfig"
UBOOT_DEVICETREE = "ast2600-evb"
SPL_BINARY = "spl/u-boot-spl.bin"
UBOOT_FITIMAGE_ENABLE = "1"

# Kernel Build Settings
KERNEL_DEVICETREE = "aspeed/aspeed-ast2600-evb.dtb"
KBUILD_DEFCONFIG = "aspeed_g6_defconfig"

MACHINE_FEATURES += "\
        obmc-phosphor-fan-mgmt \
        obmc-phosphor-chassis-mgmt \
        obmc-phosphor-flash-mgmt \
        obmc-host-ipmi \
        obmc-host-state-mgmt \
        obmc-chassis-state-mgmt \
        obmc-bmc-state-mgmt \
        "

PREFERRED_PROVIDER_virtual/obmc-system-mgmt = "packagegroup-aspeed-obmc"
PREFERRED_PROVIDER_virtual/obmc-host-ipmi-hw = "phosphor-ipmi-kcs"
VIRTUAL-RUNTIME_obmc-host-state-manager ?= "x86-power-control"
VIRTUAL-RUNTIME_obmc-chassis-state-manager ?= "x86-power-control"

EXTRA_IMAGEDEPENDS:append = " \
    aspeed-image-recoveryuart \
    "
```

## meta-aspeed-sdk/meta-ast2600-sdk/conf/machine/ast2600-emmc-515.conf
```bitbake
require conf/machine/ast2600-emmc.conf

# Kernel Build Settings
KERNEL_DEVICETREE = "aspeed-ast2600-evb.dtb"

PREFERRED_VERSION_linux-aspeed = "5.15+%"
```

## meta-aspeed-sdk/meta-ast2600-sdk/conf/machine/ast2600-emmc-612.conf
```bitbake
require conf/machine/ast2600-emmc.conf

PREFERRED_VERSION_linux-aspeed = "6.12+%"
```

## meta-aspeed-sdk/meta-ast2600-sdk/conf/machine/ast2600-emmc-secure-515.conf
```bitbake
require conf/machine/ast2600-emmc-secure.conf

# Kernel Build Settings
KERNEL_DEVICETREE = "aspeed-ast2600-evb.dtb"

PREFERRED_VERSION_linux-aspeed = "5.15+%"
```

## meta-aspeed-sdk/meta-ast2600-sdk/conf/machine/ast2600-emmc-secure-tee-515.conf
```bitbake
require conf/machine/ast2600-emmc-secure-tee.conf

# Kernel Build Settings
KERNEL_DEVICETREE = "aspeed-ast2600-evb-tee.dtb"

PREFERRED_VERSION_linux-aspeed = "5.15+%"
```

## meta-aspeed-sdk/meta-ast2600-sdk/conf/machine/ast2600-emmc-tee-612.conf
```bitbake
require conf/machine/ast2600-emmc-tee.conf

PREFERRED_VERSION_linux-aspeed = "6.12+%"
```

## meta-aspeed-sdk/meta-ast2600-sdk/conf/machine/ast2600-emmc.conf
```bitbake
require conf/machine/include/ast2600-sdk.inc
require conf/machine/include/ast-mmc.inc
require conf/distro/include/phosphor-mmc.inc
require conf/machine/include/ast-ssp.inc
require conf/machine/include/ast2600-secure-customize-gen.inc
require conf/machine/include/obmc-bsp-common.inc

# eMMC Partition Layout File
WKS_FILE = "ast2600-emmc.wks.in"

# U-Boot Build Settings
UBOOT_MACHINE = "evb-ast2600_defconfig"
UBOOT_DEVICETREE = "ast2600-evb"
SPL_BINARY = "spl/u-boot-spl.bin"
UBOOT_FITIMAGE_ENABLE = "1"

# Kernel Build Settings
KERNEL_DEVICETREE = "aspeed/aspeed-ast2600-evb.dtb"
KBUILD_DEFCONFIG = "aspeed_g6_defconfig"

# MMC u-boot and kernel partition size
MMC_UBOOT_SIZE = "1280"
MMC_BOOT_PARTITION_SIZE = "24576"

MACHINE_FEATURES += "\
        obmc-phosphor-fan-mgmt \
        obmc-phosphor-chassis-mgmt \
        obmc-phosphor-flash-mgmt \
        obmc-host-ipmi \
        obmc-host-state-mgmt \
        obmc-chassis-state-mgmt \
        obmc-bmc-state-mgmt \
        "

PREFERRED_PROVIDER_virtual/obmc-system-mgmt = "packagegroup-aspeed-obmc"
PREFERRED_PROVIDER_virtual/obmc-host-ipmi-hw = "phosphor-ipmi-kcs"
VIRTUAL-RUNTIME_obmc-host-state-manager ?= "x86-power-control"
VIRTUAL-RUNTIME_obmc-chassis-state-manager ?= "x86-power-control"

EXTRA_IMAGEDEPENDS:append = "\
    aspeed-image-recoveryuart \
    aspeed-image-emmcboot \
    "
```

## meta-aspeed-sdk/meta-ast2600-sdk/conf/machine/include/ast2600-secure-mode.inc
```bitbake
# Secure Boot Settings for u-boot verified boot
require ast2600-secure-cot.inc

# Secure Boot Settings for OTP and SOCSEC
# The following variables can be overridden in local.conf
SOCSEC_SIGN_ENABLE ?= "1"
SOCSEC_SIGN_SOC ?= "2600"
SOCSEC_SIGN_HELPER ?= "${STAGING_DATADIR_NATIVE}/aspeed-secure-config/signing_helper.sh"
OTP_SOCSEC_KEY_DIR ?= "${STAGING_DATADIR_NATIVE}/aspeed-secure-config/keys"
OTPTOOL_KEY_DIR ?= "${OTP_SOCSEC_KEY_DIR}"
OTPTOOL_USER_DIR ?= "${STAGING_DATADIR_NATIVE}/aspeed-secure-config/ast2600/data"
OTPTOOL_SOC ?= "2600"

#
# By default, algorithm is "Mode 2 RSA4096_SHA512"
#

# Using "--no_last_bit" if users still need to add or update OEM DSS
# public keys. Please add "ecc_region": false in OTP CONFIG to disable
# ECC. Once users have done all OTP programming, then enable region ECC.
#
#OTPTOOL_EXTRA_OPTS ?= "--no_last_bit"

# RSA2048_SHA256
#OTPTOOL_CONFIGS ?= "${STAGING_DATADIR_NATIVE}/aspeed-secure-config/ast2600/otp/evbA3_RSA2048_SHA256.json"
#SOCSEC_SIGN_EXTRA_OPTS ?= " \
#    --stack_intersects_verification_region=false \
#    --rsa_key_order=big \
#    "
#SOCSEC_SIGN_ALGO ?= "RSA2048_SHA256"
#SOCSEC_SIGN_KEY ?= "${OTP_SOCSEC_KEY_DIR}/test_oem_dss_private_key_2048_1.pem"

# RSA2048_SHA256_O1
#OTPTOOL_CONFIGS ?= "${STAGING_DATADIR_NATIVE}/aspeed-secure-config/ast2600/otp/evbA3_RSA2048_SHA256_o1.json"
#SOCSEC_SIGN_ALGO ?= "AES_RSA2048_SHA256"
#SOCSEC_SIGN_KEY ?= "${OTP_SOCSEC_KEY_DIR}/test_oem_dss_private_key_2048_1.pem"
#SOCSEC_SIGN_EXTRA_OPTS ?= " \
#    --stack_intersects_verification_region=false \
#    --rsa_key_order=big \
#    --key_in_otp \
#    --aes_key ${OTP_SOCSEC_KEY_DIR}/test_aes_key.bin \
#    "

# RSA2048_SHA256_O2_PUB
#OTPTOOL_CONFIGS ?= "${STAGING_DATADIR_NATIVE}/aspeed-secure-config/ast2600/otp/evbA3_RSA2048_SHA256_o2_pub.json"
#SOCSEC_SIGN_ALGO ?= "AES_RSA2048_SHA256"
#SOCSEC_SIGN_KEY ?= "${OTP_SOCSEC_KEY_DIR}/test_oem_dss_private_key_2048_1.pem"
#SOCSEC_SIGN_EXTRA_OPTS ?= " \
#    --stack_intersects_verification_region=false \
#    --rsa_key_order=big \
#    --aes_key ${OTP_SOCSEC_KEY_DIR}/test_aes_key.bin \
#    --rsa_aes ${OTP_SOCSEC_KEY_DIR}/test_soc_private_key_2048.pem \
#    "

# RSA3072_SHA384
#OTPTOOL_CONFIGS ?= "${STAGING_DATADIR_NATIVE}/aspeed-secure-config/ast2600/otp/evbA3_RSA3072_SHA384.json"
#SOCSEC_SIGN_EXTRA_OPTS ?= " \
#    --stack_intersects_verification_region=false \
#    --rsa_key_order=big \
#    "
#SOCSEC_SIGN_ALGO ?= "RSA3072_SHA384"
#SOCSEC_SIGN_KEY ?= "${OTP_SOCSEC_KEY_DIR}/test_oem_dss_private_key_3072_1.pem"

# RSA3072_SHA384_O1
#OTPTOOL_CONFIGS ?= "${STAGING_DATADIR_NATIVE}/aspeed-secure-config/ast2600/otp/evbA3_RSA3072_SHA384_o1.json"
#SOCSEC_SIGN_ALGO ?= "AES_RSA3072_SHA384"
#SOCSEC_SIGN_KEY ?= "${OTP_SOCSEC_KEY_DIR}/test_oem_dss_private_key_3072_1.pem"
#SOCSEC_SIGN_EXTRA_OPTS ?= " \
#    --stack_intersects_verification_region=false \
#    --rsa_key_order=big \
#    --key_in_otp \
#    --aes_key ${OTP_SOCSEC_KEY_DIR}/test_aes_key.bin \
#    "

# RSA3072_SHA384_O2_PUB
#OTPTOOL_CONFIGS ?= "${STAGING_DATADIR_NATIVE}/aspeed-secure-config/ast2600/otp/evbA3_RSA3072_SHA384_o2_pub.json"
#SOCSEC_SIGN_ALGO ?= "AES_RSA3072_SHA384"
#SOCSEC_SIGN_KEY ?= "${OTP_SOCSEC_KEY_DIR}/test_oem_dss_private_key_3072_1.pem"
#SOCSEC_SIGN_EXTRA_OPTS ?= " \
#    --stack_intersects_verification_region=false \
#    --rsa_key_order=big \
#    --aes_key ${OTP_SOCSEC_KEY_DIR}/test_aes_key.bin \
#    --rsa_aes ${OTP_SOCSEC_KEY_DIR}/test_soc_private_key_3072.pem \
#    "

# RSA4096_SHA512
OTPTOOL_CONFIGS ?= "${STAGING_DATADIR_NATIVE}/aspeed-secure-config/ast2600/otp/evbA3_RSA4096_SHA512.json"
SOCSEC_SIGN_EXTRA_OPTS ?= " \
    --stack_intersects_verification_region=false \
    --rsa_key_order=big \
    "
SOCSEC_SIGN_ALGO ?= "RSA4096_SHA512"
SOCSEC_SIGN_KEY ?= "${OTP_SOCSEC_KEY_DIR}/test_oem_dss_private_key_4096_1.pem"

# RSA4096_SHA512_O1
#OTPTOOL_CONFIGS ?= "${STAGING_DATADIR_NATIVE}/aspeed-secure-config/ast2600/otp/evbA3_RSA4096_SHA512_o1.json"
#SOCSEC_SIGN_ALGO ?= "AES_RSA4096_SHA512"
#SOCSEC_SIGN_KEY ?= "${OTP_SOCSEC_KEY_DIR}/test_oem_dss_private_key_4096_1.pem"
#SOCSEC_SIGN_EXTRA_OPTS ?= " \
#    --stack_intersects_verification_region=false \
#    --rsa_key_order=big \
#    --key_in_otp \
#    --aes_key ${OTP_SOCSEC_KEY_DIR}/test_aes_key.bin \
#    "

# RSA4096_SHA512_O2_PUB
#OTPTOOL_CONFIGS ?= "${STAGING_DATADIR_NATIVE}/aspeed-secure-config/ast2600/otp/evbA3_RSA4096_SHA512_o2_pub.json"
#SOCSEC_SIGN_ALGO ?= "AES_RSA4096_SHA512"
#SOCSEC_SIGN_KEY ?= "${OTP_SOCSEC_KEY_DIR}/test_oem_dss_private_key_4096_1.pem"
#SOCSEC_SIGN_EXTRA_OPTS ?= " \
#    --stack_intersects_verification_region=false \
#    --rsa_key_order=big \
#    --aes_key ${OTP_SOCSEC_KEY_DIR}/test_aes_key.bin \
#    --rsa_aes ${OTP_SOCSEC_KEY_DIR}/test_soc_private_key_4096.pem \
#    "
```

## meta-aspeed-sdk/meta-ast2700-pfr/conf/machine/ast2700-dcscm.conf
```bitbake
require conf/machine/include/ast2700-sdk.inc
require conf/machine/include/ast-ssp.inc
require conf/machine/include/ast-tsp.inc
require conf/machine/include/ast-caliptra.inc
require conf/machine/include/ast-ibexfw.inc
require conf/machine/include/obmc-bsp-common.inc
require conf/machine/include/intel-pfr.inc

# Overwrite flash layout
FLASH_SIZE = "65536"
FLASH_CALIPTRA_SIZE:flash-65536 = "128"
FLASH_BMCU_SIZE:flash-65536 = "896"
FLASH_UBOOT_OFFSET:flash-65536 = "0"
FLASH_UBOOT_ENV_OFFSET:flash-65536 = "4096"
FLASH_KERNEL_OFFSET:flash-65536 = "4224"
FLASH_ROFS_OFFSET:flash-65536 = "13440"
FLASH_RWFS_OFFSET:flash-65536 = "50944"

# PFR settings
PFR_IMAGE_SIZE = "262144"
# 0x04000000
PFM_OFFSET_PAGE = "65536"
# 0x04220000
RC_IMAGE_PAGE = "67712"
PFR_MANIFEST = "pfr_manifest_ast2700_dcscm.json"
# 1 = SHA256
# 2 = SHA384
# 3 = LMS384
# 4 = LMS256
PFR_SHA = "2"

# CALIPTRA Settings
CALIPTRA_FW_BINARY = "ast2700-caliptra-fw.bin"

# BootMCU Build Settings
BOOTMCU_MACHINE = "ibex-ast2700_defconfig"
BOOTMCU_FW_BINARY = "ast2700-ibex-spl.bin"

# U-Boot Build Settings
UBOOT_MACHINE = "evb-ast2700_defconfig"
UBOOT_DEVICETREE = "ast2700-dcscm"
UBOOT_SIGN_ENABLE = "1"
UBOOT_FITIMAGE_ENABLE = "1"

# Kernel Build Settings
KERNEL_DEVICETREE = "aspeed/ast2700-dcscm.dtb \
                     aspeed/ast2700-dcscm_ast1700-evb.dtb \
                     aspeed/ast2700-dcscm_ast1700-evb-dual.dtb \
                     "
KBUILD_DEFCONFIG = "aspeed_g7_defconfig"

MACHINE_FEATURES += "\
        obmc-phosphor-fan-mgmt \
        obmc-phosphor-chassis-mgmt \
        obmc-phosphor-flash-mgmt \
        obmc-host-ipmi \
        obmc-host-state-mgmt \
        obmc-chassis-state-mgmt \
        obmc-bmc-state-mgmt \
        "

PREFERRED_PROVIDER_virtual/obmc-system-mgmt = "packagegroup-aspeed-obmc"
PREFERRED_PROVIDER_virtual/obmc-host-ipmi-hw = "phosphor-ipmi-kcs"
VIRTUAL-RUNTIME_obmc-host-state-manager ?= "x86-power-control"
VIRTUAL-RUNTIME_obmc-chassis-state-manager ?= "x86-power-control"

EXTRA_IMAGEDEPENDS:append = " \
    aspeed-image-recoveryuart \
    "
```

## meta-aspeed-sdk/meta-ast2700-sdk/conf/machine/ast2700-a1-raw.conf
```bitbake
require conf/machine/ast2700-a1.conf

# U-Boot Build Settings
UBOOT_DEVICETREE = "ast2700-raw"

# Kernel Build Settings
KERNEL_DEVICETREE = "aspeed/ast2700-raw.dtb"
```

## meta-aspeed-sdk/meta-ast2700-sdk/conf/machine/ast2700-a1.conf
```bitbake
require conf/machine/include/ast2700-sdk.inc
require conf/machine/include/ast-ssp.inc
require conf/machine/include/ast-tsp.inc
require conf/machine/include/ast2700-secure-customize-gen.inc
require conf/machine/include/obmc-bsp-common.inc

# Overwrite flash layout
FLASH_SIZE = "131072"
FLASH_CALIPTRA_SIZE:flash-131072 = "128"
FLASH_BMCU_SIZE:flash-131072 = "896"
FLASH_UBOOT_OFFSET:flash-131072 = "0"
FLASH_UBOOT_ENV_OFFSET:flash-131072 = "4096"
FLASH_KERNEL_OFFSET:flash-131072 = "4224"
FLASH_ROFS_OFFSET:flash-131072 = "13440"
FLASH_RWFS_OFFSET:flash-131072 = "98304"
RWFS_SIZE = "33554432"

# CALIPTRA Settings
CALIPTRA_FW_BINARY = "ast2700-caliptra-fw-v1.2.bin"
# CALIPTRA Manifest
CALIPTRA_MANIFEST_CONFIG ??= "ast2700a1-default-manifest.toml"

# BootMCU Build Settings
BOOTMCU_FW_BINARY = "ast2700-mcu-runtime.bin"
ZEPHYR_BOARD_BOOTMCU ?= "ast2700_evb/ast2700_a1/bootmcu"

# U-Boot Build Settings
UBOOT_MACHINE = "evb-ast2700_defconfig"
UBOOT_DEVICETREE = "ast2700-evb"

# Kernel Build Settings
KERNEL_DEVICETREE = "aspeed/ast2700a1-evb.dtb"
KBUILD_DEFCONFIG = "aspeed_g7_defconfig"

# SSP Settings
ZEPHYR_BOARD_SSP ?= "ast2700_evb/ast2700_a1/ssp_tsp"

# TSP Settings
ZEPHYR_BOARD_TSP ?= "ast2700_evb/ast2700_a1/tsp"

MACHINE_FEATURES += "\
        obmc-phosphor-fan-mgmt \
        obmc-phosphor-chassis-mgmt \
        obmc-phosphor-flash-mgmt \
        obmc-host-ipmi \
        obmc-host-state-mgmt \
        obmc-chassis-state-mgmt \
        obmc-bmc-state-mgmt \
        "

PREFERRED_PROVIDER_virtual/obmc-system-mgmt = "packagegroup-aspeed-obmc"
PREFERRED_PROVIDER_virtual/obmc-host-ipmi-hw = "phosphor-ipmi-kcs"
VIRTUAL-RUNTIME_obmc-host-state-manager ?= "x86-power-control"
VIRTUAL-RUNTIME_obmc-chassis-state-manager ?= "x86-power-control"

EXTRA_IMAGEDEPENDS:append = " \
    aspeed-image-recoveryuart \
    "
```

## meta-aspeed-sdk/meta-ast2700-sdk/conf/machine/ast2700-default-66.conf
```bitbake
require conf/machine/ast2700-default.conf

PREFERRED_VERSION_linux-aspeed = "6.6+%"
```

## meta-aspeed-sdk/meta-ast2700-sdk/conf/machine/ast2700-default-raw.conf
```bitbake
require conf/machine/ast2700-default.conf

# U-Boot Build Settings
UBOOT_DEVICETREE = "ast2700-raw"

# Kernel Build Settings
KERNEL_DEVICETREE = "aspeed/ast2700-raw.dtb"
```

## meta-aspeed-sdk/meta-ast2700-sdk/conf/machine/ast2700-default-secure.conf
```bitbake
require conf/machine/ast2700-default.conf
require conf/machine/include/ast-secure.inc
require conf/machine/include/ast2700-secure-mode.inc
require conf/machine/include/ast2700-secure-customize-gen.inc
```
