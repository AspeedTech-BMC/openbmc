## meta-aspeed-sdk/meta-ast2700-sdk/conf/machine/ast2700-default.conf
```bitbake
require conf/machine/include/ast2700-sdk.inc
require conf/machine/include/ast-ssp.inc
require conf/machine/include/ast-tsp.inc
require conf/machine/include/ast-caliptra.inc
require conf/machine/include/ast-ibexfw.inc
require conf/machine/include/obmc-bsp-common.inc

# Overwrite flash layout
FLASH_SIZE = "131072"
FLASH_CALIPTRA_SIZE:flash-131072 = "128"
FLASH_BMCU_SIZE:flash-131072 = "896"
FLASH_UBOOT_OFFSET:flash-131072 = "0"
FLASH_UBOOT_ENV_OFFSET:flash-131072 = "4096"
FLASH_KERNEL_OFFSET:flash-131072 = "4224"
FLASH_ROFS_OFFSET:flash-131072 = "13440"
FLASH_RWFS_OFFSET:flash-131072 = "98304"
RWFS_SIZE = "33554432"

# CALIPTRA Settings
CALIPTRA_FW_BINARY = "ast2700-caliptra-fw.bin"

# BootMCU Build Settings
BOOTMCU_MACHINE = "ibex-ast2700_defconfig"
BOOTMCU_FW_BINARY = "ast2700-ibex-spl.bin"

# U-Boot Build Settings
UBOOT_MACHINE = "evb-ast2700_defconfig"
UBOOT_DEVICETREE = "ast2700-evb"
UBOOT_SIGN_ENABLE = "1"
UBOOT_FITIMAGE_ENABLE = "1"

# Kernel Build Settings
KERNEL_DEVICETREE = "aspeed/ast2700-evb.dtb"
KBUILD_DEFCONFIG = "aspeed_g7_defconfig"

MACHINE_FEATURES += "\
        obmc-phosphor-fan-mgmt \
        obmc-phosphor-chassis-mgmt \
        obmc-phosphor-flash-mgmt \
        obmc-host-ipmi \
        obmc-host-state-mgmt \
        obmc-chassis-state-mgmt \
        obmc-bmc-state-mgmt \
        "

PREFERRED_PROVIDER_virtual/obmc-system-mgmt = "packagegroup-aspeed-obmc"
PREFERRED_PROVIDER_virtual/obmc-host-ipmi-hw = "phosphor-ipmi-kcs"
VIRTUAL-RUNTIME_obmc-host-state-manager ?= "x86-power-control"
VIRTUAL-RUNTIME_obmc-chassis-state-manager ?= "x86-power-control"

EXTRA_IMAGEDEPENDS:append = " \
    aspeed-image-recoveryuart \
    "
```

## meta-aspeed-sdk/meta-ast2700-sdk/conf/machine/ast2700-gp-default-612.conf
```bitbake
require conf/machine/ast2700-gp-default.conf

PREFERRED_VERSION_linux-aspeed = "6.12+%"
```

## meta-aspeed-sdk/meta-ast2700-sdk/conf/machine/ast2700-gp-default-ncsi.conf
```bitbake
require conf/machine/ast2700-gp-default.conf

# U-Boot Build Settings
UBOOT_DEVICETREE = "ast2700-ncsi"

# Kernel Build Settings
KERNEL_DEVICETREE = "aspeed/ast2700-ncsi.dtb"
```

## meta-aspeed-sdk/meta-ast2700-sdk/conf/machine/ast2700-irot.conf
```bitbake
require conf/distro/include/phosphor-static-norootfs.inc
require conf/machine/include/ast2700-sdk.inc
require conf/machine/include/ast-irot.inc
require conf/machine/include/ast-ssp.inc
require conf/machine/include/obmc-bsp-common.inc
require conf/distro/include/pldm.inc

# ast2700-irot flash layout
FLASH_SIZE = "131072"
FLASH_UBOOT_OFFSET:flash-131072 = "0"
FLASH_UBOOT_ENV_OFFSET:flash-131072 = "4160"
FLASH_MANIFEST_OFFSET:flash-131072 = "4096"
FLASH_KERNEL_OFFSET:flash-131072 = "4224"
FLASH_RWFS_OFFSET:flash-131072 = "98304"

# CALIPTRA Settings
CALIPTRA_FW_BINARY = "caliptra-fw-v2.bin"

# CALIPTRA Manifest
CPTRA_TOML_LOAD_STAGE_ATF ?= "2"
CPTRA_TOML_LOAD_STAGE_TEE ?= "2"
CPTRA_TOML_LOAD_STAGE_UBOOT ?= "2"
CPTRA_TOML_IMG_KERNEL ?= "obmc-phosphor-image-ast2700-irot.cpio.zst.fitImage"
CPTRA_TOML_LOAD_STAGE_KERNEL ?= "2"
CPTRA_TOML_LMS_ENABLE ?= "1"
UBOOT_FIT_SSP_IMAGE = "${DEPLOY_DIR_IMAGE}/zephyr-aspeed-ssp-irot.bin"

# BootMCU Build Settings
BOOTMCU_FW_BINARY = "ast2700-mcu-runtime.bin"

# U-Boot Build Settings
UBOOT_MACHINE = "evb-ast2700_defconfig"
UBOOT_DEVICETREE = "ast2700-evb"

# Kernel Build Settings
KERNEL_DEVICETREE = "aspeed/ast2700-irot.dtb"
KBUILD_DEFCONFIG = "aspeed_g7_defconfig"

MACHINE_FEATURES += "\
        obmc-phosphor-fan-mgmt \
        obmc-phosphor-chassis-mgmt \
        obmc-phosphor-flash-mgmt \
        obmc-host-ipmi \
        obmc-host-state-mgmt \
        obmc-chassis-state-mgmt \
        obmc-bmc-state-mgmt \
        "

PREFERRED_PROVIDER_virtual/ssp ?= "zephyr-aspeed-ssp-irot"
PREFERRED_PROVIDER_virtual/obmc-system-mgmt = "packagegroup-aspeed-obmc"
PREFERRED_PROVIDER_virtual/obmc-host-ipmi-hw = "phosphor-ipmi-kcs"
VIRTUAL-RUNTIME_obmc-host-state-manager ?= "x86-power-control"
VIRTUAL-RUNTIME_obmc-chassis-state-manager ?= "x86-power-control"
```
