## meta-evb/meta-evb-aspeed/meta-evb-pilot4/conf/layer.conf
```bitbake
# We have a conf and classes directory, add to BBPATH
BBPATH .= ":${LAYERDIR}"

# We have recipes-* directories, add to BBFILES
BBFILES += "${LAYERDIR}/recipes-*/*/*.bb \
            ${LAYERDIR}/recipes-*/*/*.bbappend"

BBFILE_COLLECTIONS += "evb-pilot4"
BBFILE_PATTERN_evb-pilot4 = ""
KERNEL_FEATURES_remove = "phosphor-gpio-keys"
```

## meta-evb/meta-evb-aspeed/meta-evb-pilot4/conf/machine/evb-pilot4.conf
```bitbake
KMACHINE = "pilot4"
KERNEL_DEVICETREE = "${KMACHINE}_asic.dtb"

#UBOOT_MACHINE = "pilot4_orion_config"
UBOOT_MACHINE = "pilot_config"
OBMC_MACHINE_FEATURES += "obmc-host-ipmi"

FLASH_SIZE = "32768"

require conf/machine/include/pilot4.inc
require conf/machine/include/obmc-bsp-common.inc
```

## meta-zephyr/meta-zephyr-bsp/conf/layer.conf
```bitbake
# We have a conf and classes directory, add to BBPATH
BBPATH .= ":${LAYERDIR}"

# We have recipes-* directories, add to BBFILES
BBFILES += "${LAYERDIR}/recipes-*/*/*.bb \
	${LAYERDIR}/recipes-*/*/*.bbappend"

BBFILE_COLLECTIONS += "zephyrbsp"
BBFILE_PATTERN_zephyrbsp = "^${LAYERDIR}/"
BBFILE_PRIORITY_zephyrbsp = "6"

# This should only be incremented on significant changes that will
# cause compatibility issues with other layers
LAYERVERSION_zephyrbsp = "1"

LAYERDEPENDS_zephyrbsp = "zephyrcore core meta-python"

LAYERSERIES_COMPAT_zephyrbsp = "scarthgap styhead walnascar"
```

## meta-zephyr/meta-zephyr-bsp/conf/machine/96b-avenger96.conf
```bitbake
#@TYPE: Machine
#@NAME: 96b_avenger96

#@DESCRIPTION: Machine configuration for 96Boards Avenger96 Board.

require conf/machine/include/stm32mp1-cortex-m4.inc
```

## meta-zephyr/meta-zephyr-bsp/conf/machine/96b-nitrogen.conf
```bitbake
#@TYPE: Machine
#@NAME: 96b_nitrogen

#@DESCRIPTION: Machine configuration for 96Boards Nitrogen Board.

require conf/machine/include/nrf52.inc
ZEPHYR_INHERIT_CLASSES += "zephyr-flash-pyocd"
```

## meta-zephyr/meta-zephyr-bsp/conf/machine/arduino-nano-33-ble.conf
```bitbake
#@TYPE: Machine
#@NAME: arduino-nano-33-ble

#@DESCRIPTION: Machine configuration for Arudino nano 33 ble and Arduino nano 33 ble sense

require conf/machine/include/nrf52.inc
ZEPHYR_INHERIT_CLASSES += "zephyr-flash-bossac"
```

## meta-zephyr/meta-zephyr-bsp/conf/machine/intel-x86-64.conf
```bitbake
#@TYPE: Machine
#@NAME: intel-x86-64
#@DESCRIPTION: common MACHINE for 64-bit x86 boards. User must set ${ZEPHYR_BOARD}. By default is set to 'intel_ehl_crb' board.

require conf/machine/include/tune-corei7-common.inc


# Supported Boards:
# ZEPHYR_BOARD ?= "acrn"
# ZEPHYR_BOARD ?= "acrn_ehl_crb"
# ZEPHYR_BOARD ?= "up_squared"
# ZEPHYR_BOARD ?= "intel_ehl_crb_sbl"
ZEPHYR_BOARD ?= "intel_ehl_crb"
```

## meta-zephyr/meta-zephyr-bsp/conf/machine/mps2-an385.conf
```bitbake
#@TYPE: Machine
#@NAME: mps2-an385
#@DESCRIPTION: Machine for Zephyr BOARD mps2-an385

require conf/machine/include/qemu.inc
require conf/machine/include/arm/armv7m/tune-cortexm3.inc

TCLIBC = "newlib"

# For runqemu
QB_SYSTEM_NAME = "qemu-system-arm"
QB_MACHINE = "-machine mps2-an385"
QB_CPU = "-cpu cortex-m3"
QB_GRAPHICS = "-nographic -vga none"
QB_OPT_APPEND = "-icount shift=7,align=off,sleep=off -rtc clock=vm"

# Zephyr RTOS settings
ZEPHYR_INHERIT_CLASSES += "zephyr-qemuboot"
```

## meta-zephyr/meta-zephyr-bsp/conf/machine/mps2-an521.conf
```bitbake
#@TYPE: Machine
#@NAME: mps2-an521
#@DESCRIPTION: Machine for Zephyr BOARD mps2-an521

DEFAULTTUNE ?= "armv8m-main"
require conf/machine/include/qemu.inc
require conf/machine/include/arm/armv8-m/tune-cortexm33.inc

TCLIBC = "newlib"

# For runqemu
QB_SYSTEM_NAME = "qemu-system-arm"
QB_MACHINE = "-machine mps2-an521"
QB_CPU = "-cpu cortex-m33"
QB_MEM = "-m 16"
QB_GRAPHICS = "-nographic -vga none"
QB_OPT_APPEND = "-icount shift=7,align=off,sleep=off -rtc clock=vm"

# Zephyr RTOS settings
ZEPHYR_INHERIT_CLASSES += "zephyr-qemuboot"
```

## meta-zephyr/meta-zephyr-bsp/conf/machine/mps3-an547.conf
```bitbake
#@TYPE: Machine
#@NAME: mps3-an547
#@DESCRIPTION: Machine for Zephyr BOARD mps3-an547

DEFAULTTUNE ?= "armv8-1m-main"
require conf/machine/include/qemu.inc
require conf/machine/include/arm/armv8-1m/tune-cortexm55.inc

TCLIBC = "newlib"

# For runqemu
QB_SYSTEM_NAME = "qemu-system-arm"
QB_MACHINE = "-machine mps3-an547"
QB_CPU = "-cpu cortex-m55"
QB_MEM = "-m 2048"
QB_GRAPHICS = "-vga none"
QB_OPT_APPEND = "-icount shift=7,align=off,sleep=off -rtc clock=vm"
QB_RNG = ""

# Zephyr RTOS settings
ZEPHYR_BOARD = "mps3/corstone300/an547"
ZEPHYR_INHERIT_CLASSES += "zephyr-qemuboot"
```
