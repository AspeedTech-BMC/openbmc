## meta-aspeed-sdk/conf/machine/include/oldest-kernel-54.inc
```bitbake
# glibc
# --enable-kernel=version
# This option is currently only useful on GNU/Linux systems.
# The version parameter should have the form X.Y.Z and describes the smallest
# version of the Linux kernel the generated library is expected to support.
# The higher the version number is, the less compatibility code is added,
# and the faster the code gets.

# Yocto set the oldest kernel version to 5.15 in bitbake.conf
# To support kernel 5.4 and fix compatible issue, set oldest kernel version to
# 5.4 in ASPEED SDK.
OLDEST_KERNEL = "5.4"
```

## meta-aspeed-sdk/meta-aspeed-pfr/conf/layer.conf
```bitbake
# We have a conf and classes directory, add to BBPATH
BBPATH .= ":${LAYERDIR}"

# We have recipes-* directories, add to BBFILES
BBFILES += "${LAYERDIR}/recipes-*/*/*.bb \
            ${LAYERDIR}/recipes-*/*/*.bbappend"

BBFILE_COLLECTIONS += "aspeed-pfr-layer"
BBFILE_PATTERN_aspeed-pfr-layer := "^${LAYERDIR}/"
LAYERSERIES_COMPAT_aspeed-pfr-layer = "scarthgap styhead"
```

## meta-aspeed-sdk/meta-ast2600-sdk/conf/machine/ast2600-default-raw.conf
```bitbake
require conf/machine/ast2600-default.conf

# U-Boot Build Settings
UBOOT_DEVICETREE = "ast2600-raw"

# Kernel Build Settings
KERNEL_DEVICETREE = "aspeed/aspeed-ast2600-raw.dtb"
```

## meta-aspeed-sdk/meta-ast2600-sdk/conf/machine/ast2600-default-tee.conf
```bitbake
require conf/machine/ast2600-default.conf
require conf/machine/include/ast-optee-os.inc

# U-Boot Build Settings
UBOOT_DEVICETREE = "ast2600-evb-tee"

# Kernel Build Settings
KERNEL_DEVICETREE = "aspeed/aspeed-ast2600-evb-tee.dtb"
```

## meta-aspeed-sdk/meta-ast2600-sdk/conf/machine/include/ast2600-secure-cot.inc
```bitbake
# Secure Boot Settings for u-boot verified boot
#
# By default, algorithm is "sha512,rsa4096"
#
# The following variables can be overridden in local.conf
#

SPL_SIGN_ENABLE ?= "1"
SPL_SIGN_KEYDIR ?= "${STAGING_DATADIR_NATIVE}/aspeed-secure-config/keys"

UBOOT_SIGN_ENABLE ?= "1"
UBOOT_SIGN_KEYDIR ?= "${STAGING_DATADIR_NATIVE}/aspeed-secure-config/keys"


# Algorithm "sha512,rsa4096"
SPL_SIGN_KEYNAME ?= "test_bl2_4096"
UBOOT_SIGN_KEYNAME ?= "test_bl3_4096"

# Kernel / Bootloader fitImage Hash Algo
FIT_HASH_ALG ?= "sha512"
UBOOT_FIT_HASH_ALG ?= "sha512"

# Kernel / Bootloader fitImage Signature Algo
FIT_SIGN_ALG ?= "rsa4096"
UBOOT_FIT_SIGN_ALG ?= "rsa4096"

# Size of private keys in number of bits
FIT_SIGN_NUMBITS ?= "4096"
UBOOT_FIT_SIGN_NUMBITS ?= "4096"


# Algorithm "sha384,rsa3072"
#SPL_SIGN_KEYNAME ?= "test_bl2_3072"
#UBOOT_SIGN_KEYNAME ?= "test_bl3_3072"

# Kernel / Bootloader fitImage Hash Algo
#FIT_HASH_ALG ?= "sha384"
#UBOOT_FIT_HASH_ALG ?= "sha384"

# Kernel / Bootloader fitImage Signature Algo
#FIT_SIGN_ALG ?= "rsa3072"
#UBOOT_FIT_SIGN_ALG ?= "rsa3072"

# Size of private keys in number of bits
#FIT_SIGN_NUMBITS ?= "3072"
#UBOOT_FIT_SIGN_NUMBITS ?= "3072"


# Algorithm "sha256,rsa2048"
#SPL_SIGN_KEYNAME ?= "test_bl2_2048"
#UBOOT_SIGN_KEYNAME ?= "test_bl3_2048"

# Kernel / Bootloader fitImage Hash Algo
#FIT_HASH_ALG ?= "sha256"
#UBOOT_FIT_HASH_ALG ?= "sha256"

# Kernel / Bootloader fitImage Signature Algo
#FIT_SIGN_ALG ?= "rsa2048"
#UBOOT_FIT_SIGN_ALG ?= "rsa2048"

# Size of private keys in number of bits
#FIT_SIGN_NUMBITS ?= "2048"
#UBOOT_FIT_SIGN_NUMBITS ?= "2048"
```

## meta-aspeed-sdk/meta-ast2700-pfr/conf/machine/ast2700-a0-dcscm.conf
```bitbake
require conf/machine/include/ast2700-sdk.inc
require conf/machine/include/ast2700-a0.inc
require conf/machine/include/obmc-bsp-common.inc
require conf/machine/include/intel-pfr.inc

# Overwrite flash layout
FLASH_SIZE = "65536"
FLASH_BMCU_SIZE:flash-65536 = "768"
FLASH_UBOOT_OFFSET:flash-65536 = "0"
FLASH_UBOOT_ENV_OFFSET:flash-65536 = "2048"
FLASH_KERNEL_OFFSET:flash-65536 = "2176"
FLASH_ROFS_OFFSET:flash-65536 = "11392"
FLASH_RWFS_OFFSET:flash-65536 = "48896"

# PFR settings
PFR_IMAGE_SIZE = "262144"
# 0x04000000
PFM_OFFSET_PAGE = "65536"
# 0x04220000
RC_IMAGE_PAGE = "67712"
PFR_MANIFEST = "pfr_manifest_ast2700_a0_dcscm.json"
# 1 = SHA256
# 2 = SHA384
# 3 = LMS384
# 4 = LMS256
PFR_SHA = "2"

# BootMCU Build Settings
BOOTMCU_MACHINE = "ibex-ast2700a0_defconfig"
BOOTMCU_FW_BINARY = "ast2700a0-ibex-spl.bin"

# U-Boot Build Settings
UBOOT_MACHINE = "evb-ast2700a0_defconfig"
UBOOT_DEVICETREE = "ast2700-evb"
UBOOT_SIGN_ENABLE = "1"
UBOOT_FITIMAGE_ENABLE = "1"

# Kernel Build Settings
KERNEL_DEVICETREE = "aspeed/ast2700a0-dcscm.dtb"
KBUILD_DEFCONFIG = "aspeed_g7_defconfig"

MACHINE_FEATURES += "\
        obmc-phosphor-fan-mgmt \
        obmc-phosphor-chassis-mgmt \
        obmc-phosphor-flash-mgmt \
        obmc-host-ipmi \
        obmc-host-state-mgmt \
        obmc-chassis-state-mgmt \
        obmc-bmc-state-mgmt \
        "

PREFERRED_PROVIDER_virtual/obmc-system-mgmt = "packagegroup-aspeed-obmc"
PREFERRED_PROVIDER_virtual/obmc-host-ipmi-hw = "phosphor-ipmi-kcs"
VIRTUAL-RUNTIME_obmc-host-state-manager ?= "x86-power-control"
VIRTUAL-RUNTIME_obmc-chassis-state-manager ?= "x86-power-control"

EXTRA_IMAGEDEPENDS:append = " \
    aspeed-image-recoveryuart \
    "
```

## meta-aspeed-sdk/meta-ast2700-sdk/conf/machine/ast2700-a0-emmc.conf
```bitbake
require conf/machine/include/ast2700-sdk.inc
require conf/machine/include/ast2700-a0.inc
require conf/machine/include/ast-mmc.inc
require conf/distro/include/phosphor-mmc.inc
require conf/machine/include/obmc-bsp-common.inc

# eMMC Partition Layout File
WKS_FILE = "ast2700-emmc.wks.in"

# BootMCU Build Settings
BOOTMCU_MACHINE = "ibex-ast2700a0_defconfig"
BOOTMCU_FW_BINARY = "ast2700a0-ibex-spl.bin"

# U-Boot Build Settings
UBOOT_MACHINE = "evb-ast2700a0_defconfig"
UBOOT_DEVICETREE = "ast2700-evb"
UBOOT_SIGN_ENABLE = "1"
UBOOT_FITIMAGE_ENABLE = "1"

# Kernel Build Settings
KERNEL_DEVICETREE = "aspeed/ast2700a0-evb.dtb"
KBUILD_DEFCONFIG = "aspeed_g7_defconfig"

# MMC u-boot and kernel partition size
# Boot partition has 2MB,
# so bootmuc-spl and bootloader-fit has 2048kb.
FLASH_BMCU_SIZE = "768"
MMC_UBOOT_SIZE = "2048"
MMC_BOOT_PARTITION_SIZE = "24576"

MACHINE_FEATURES += "\
        obmc-phosphor-fan-mgmt \
        obmc-phosphor-chassis-mgmt \
        obmc-phosphor-flash-mgmt \
        obmc-host-ipmi \
        obmc-host-state-mgmt \
        obmc-chassis-state-mgmt \
        obmc-bmc-state-mgmt \
        "

PREFERRED_PROVIDER_virtual/obmc-system-mgmt = "packagegroup-aspeed-obmc"
PREFERRED_PROVIDER_virtual/obmc-host-ipmi-hw = "phosphor-ipmi-kcs"
VIRTUAL-RUNTIME_obmc-host-state-manager ?= "x86-power-control"
VIRTUAL-RUNTIME_obmc-chassis-state-manager ?= "x86-power-control"

EXTRA_IMAGEDEPENDS:append = " \
    aspeed-image-recoveryuart \
    "
```

## meta-aspeed-sdk/meta-ast2700-sdk/conf/machine/ast2700-abr.conf
```bitbake
require conf/machine/ast2700-default.conf

# Kernel Build Settings
# Use ast2700-evb-256-abr.dts for AST2700 single flash ABR.
KERNEL_DEVICETREE = "aspeed/ast2700-evb-256-abr.dtb"
```

## meta-aspeed-sdk/meta-ast2700-sdk/conf/machine/ast2700-default-ncsi.conf
```bitbake
require conf/machine/ast2700-default.conf

# U-Boot Build Settings
UBOOT_DEVICETREE = "ast2700-ncsi"

# Kernel Build Settings
KERNEL_DEVICETREE = "aspeed/ast2700-ncsi.dtb"
```

## meta-aspeed/conf/machine/evb-ast2600.conf
```bitbake
### OpenBMC
#KERNEL_DEVICETREE = "aspeed-ast2600-evb.dtb"
#UBOOT_MACHINE = "ast2600_openbmc_defconfig"
#UBOOT_DEVICETREE = "ast2600a1-evb"

### ASPEED SDK
KERNEL_DEVICETREE = "aspeed-ast2600a1-evb.dtb"
SPL_BINARY = "spl/u-boot-spl.${UBOOT_SUFFIX}"
UBOOT_MACHINE = "evb-ast2600-spl_defconfig"
UBOOT_DEVICETREE = "ast2600a1-evb"
UBOOT_SUFFIX = "bin"
IMAGE_BOOT_FILES ?= "u-boot-spl.${UBOOT_SUFFIX} u-boot.${UBOOT_SUFFIX}"


require conf/machine/include/ast2600.inc

SERIAL_CONSOLES = "115200;ttyS4"
```

## meta-aspeed/meta-pilot/conf/machine/include/pilot4.inc
```bitbake
#@TYPE: Machine
#@NAME: Aspeed PILOT4
#@DESCRIPTION: Common machine configuration for the Aspeed PILOT4 Chip

require conf/machine/include/aspeed.inc

#UBOOT_MACHINE ?= "ast_g5_ncsi_config"
UBOOT_ENTRYPOINT ?= "0x81008000"
UBOOT_LOADADDRESS ?= "0x81008000"
UBOOT_RD_LOADADDRESS ?= "0x84000000"
UBOOT_RD_ENTRYPOINT ?= "0x84000000"

MACHINE_EXTRA_RDEPENDS += "udev-aspeed-vuart"

DEFAULTTUNE ?= "arm7a-novfp"

SERIAL_CONSOLES = "115200;ttyS0"

SOC_FAMILY = "pilot4_asic"
#include conf/machine/include/soc-family.inc
MACHINEOVERRIDES .= ":pilot4"

require conf/machine/include/tune-arm7a-novfp.inc
```

## meta-aspeed/meta-pilot/recipes-kernel/linux/files/defconfig
```kconfig
CONFIG_COMPILE_TEST=y
CONFIG_KERNEL_XZ=y
# CONFIG_SWAP is not set
CONFIG_SYSVIPC=y
CONFIG_USELIB=y
CONFIG_HZ_PERIODIC=y
CONFIG_NO_HZ=y
CONFIG_HIGH_RES_TIMERS=y
# CONFIG_CPU_ISOLATION is not set
CONFIG_CGROUPS=y
CONFIG_MEMCG=y
CONFIG_CGROUP_SCHED=y
CONFIG_CFS_BANDWIDTH=y
CONFIG_RT_GROUP_SCHED=y
CONFIG_CGROUP_FREEZER=y
CONFIG_CGROUP_DEVICE=y
CONFIG_CGROUP_CPUACCT=y
CONFIG_BLK_DEV_INITRD=y
# CONFIG_RD_GZIP is not set
# CONFIG_RD_BZIP2 is not set
CONFIG_KALLSYMS_ALL=y
CONFIG_BPF_SYSCALL=y
CONFIG_EMBEDDED=y
# CONFIG_COMPAT_BRK is not set
CONFIG_ARCH_PILOT=y
# CONFIG_KUSER_HELPERS is not set
# CONFIG_VDSO is not set
CONFIG_SMP=y
CONFIG_HAVE_ARM_ARCH_TIMER=y
CONFIG_VMSPLIT_2G=y
CONFIG_NR_CPUS=2
CONFIG_OABI_COMPAT=y
CONFIG_HIGHMEM=y
# CONFIG_HIGHPTE is not set
# CONFIG_CPU_SW_DOMAIN_PAN is not set
CONFIG_CRASH_DUMP=y
CONFIG_FPE_NWFPE=y
CONFIG_FPE_NWFPE_XP=y
# CONFIG_ARM_SCMI_POWER_DOMAIN is not set
# CONFIG_ARM_SCPI_POWER_DOMAIN is not set
CONFIG_FIRMWARE_MEMMAP=y
CONFIG_KPROBES=y
# CONFIG_STRICT_KERNEL_RWX is not set
CONFIG_MODULES=y
# CONFIG_LBDAF is not set
# CONFIG_BLK_DEV_BSG is not set
# CONFIG_BLK_DEBUG_FS is not set
CONFIG_PARTITION_ADVANCED=y
# CONFIG_MSDOS_PARTITION is not set
# CONFIG_EFI_PARTITION is not set
# CONFIG_IOSCHED_DEADLINE is not set
# CONFIG_MQ_IOSCHED_DEADLINE is not set
# CONFIG_MQ_IOSCHED_KYBER is not set
CONFIG_BINFMT_MISC=y
CONFIG_KSM=y
CONFIG_CLEANCACHE=y
CONFIG_CMA=y
CONFIG_ZPOOL=y
CONFIG_ZBUD=y
CONFIG_NET=y
CONFIG_PACKET=y
CONFIG_PACKET_DIAG=y
CONFIG_UNIX=y
CONFIG_UNIX_DIAG=y
CONFIG_INET=y
# CONFIG_INET_XFRM_MODE_TRANSPORT is not set
# CONFIG_INET_XFRM_MODE_TUNNEL is not set
# CONFIG_INET_XFRM_MODE_BEET is not set
CONFIG_TCP_CONG_ADVANCED=y
# CONFIG_TCP_CONG_BIC is not set
# CONFIG_TCP_CONG_WESTWOOD is not set
# CONFIG_TCP_CONG_HTCP is not set
# CONFIG_WIRELESS is not set
# CONFIG_UEVENT_HELPER is not set
CONFIG_DEVTMPFS=y
CONFIG_DEVTMPFS_MOUNT=y
# CONFIG_STANDALONE is not set
CONFIG_MTD=y
CONFIG_MTD_BLOCK=y
CONFIG_MTD_CFI=y
CONFIG_MTD_PHYSMAP_OF=y
CONFIG_MTD_SPI_NOR=y
CONFIG_SPI_PILOT_SPI=y
CONFIG_BLK_DEV_LOOP=y
CONFIG_BLK_DEV_NBD=y
CONFIG_PILOT_LPC_SNOOP=y
CONFIG_PILOT_LPC_MBOX=y
CONFIG_NETDEVICES=y
# CONFIG_NET_VENDOR_ALACRITECH is not set
# CONFIG_NET_VENDOR_AMAZON is not set
# CONFIG_NET_VENDOR_AQUANTIA is not set
# CONFIG_NET_VENDOR_ARC is not set
# CONFIG_NET_VENDOR_BROADCOM is not set
# CONFIG_NET_VENDOR_CIRRUS is not set
# CONFIG_NET_VENDOR_CORTINA is not set
CONFIG_PILOT4_NET_TULIP=y
# CONFIG_NET_VENDOR_EZCHIP is not set
# CONFIG_NET_VENDOR_FARADAY is not set
# CONFIG_NET_VENDOR_FREESCALE is not set
# CONFIG_NET_VENDOR_HISILICON is not set
# CONFIG_NET_VENDOR_HUAWEI is not set
# CONFIG_NET_VENDOR_INTEL is not set
# CONFIG_NET_VENDOR_MARVELL is not set
# CONFIG_NET_VENDOR_MELLANOX is not set
# CONFIG_NET_VENDOR_MICREL is not set
# CONFIG_NET_VENDOR_NATSEMI is not set
# CONFIG_NET_VENDOR_NETRONOME is not set
# CONFIG_NET_VENDOR_NI is not set
# CONFIG_NET_VENDOR_QUALCOMM is not set
# CONFIG_NET_VENDOR_RENESAS is not set
# CONFIG_NET_VENDOR_ROCKER is not set
# CONFIG_NET_VENDOR_SAMSUNG is not set
# CONFIG_NET_VENDOR_SEEQ is not set
# CONFIG_NET_VENDOR_SOLARFLARE is not set
# CONFIG_NET_VENDOR_SMSC is not set
# CONFIG_NET_VENDOR_SOCIONEXT is not set
# CONFIG_NET_VENDOR_STMICRO is not set
# CONFIG_NET_VENDOR_SYNOPSYS is not set
# CONFIG_NET_VENDOR_VIA is not set
# CONFIG_NET_VENDOR_WIZNET is not set
# CONFIG_WLAN is not set
# CONFIG_INPUT_KEYBOARD is not set
# CONFIG_INPUT_MOUSE is not set
# CONFIG_SERIO is not set
# CONFIG_LEGACY_PTYS is not set
CONFIG_SERIAL_8250=y
# CONFIG_SERIAL_8250_DEPRECATED_OPTIONS is not set
CONFIG_SERIAL_8250_CONSOLE=y
CONFIG_SERIAL_8250_NR_UARTS=3
CONFIG_SERIAL_8250_RUNTIME_UARTS=3
CONFIG_SERIAL_8250_EXTENDED=y
CONFIG_SERIAL_8250_PILOT_VUART=y
CONFIG_SERIAL_OF_PLATFORM=y
CONFIG_SERIAL_DEV_BUS=y
CONFIG_IPMI_HANDLER=y
CONFIG_IPMI_PANIC_EVENT=y
CONFIG_IPMI_PANIC_STRING=y
CONFIG_IPMI_DEVICE_INTERFACE=y
CONFIG_IPMI_SI=y
CONFIG_IPMI_SSIF=y
CONFIG_IPMI_WATCHDOG=y
CONFIG_IPMI_POWEROFF=y
CONFIG_PILOT_KCS_IPMI_BMC=y
CONFIG_PILOT_BT_IPMI_BMC=y
# CONFIG_HW_RANDOM is not set
# CONFIG_I2C_COMPAT is not set
CONFIG_I2C_CHARDEV=y
CONFIG_I2C_MUX=y
# CONFIG_I2C_HELPER_AUTO is not set
CONFIG_I2C_ALGOBIT=y
CONFIG_I2C_PILOT=y
# CONFIG_I2C_BRCMSTB is not set
CONFIG_I2C_SLAVE=y
CONFIG_I2C_SLAVE_EEPROM=y
CONFIG_I2C_DEBUG_BUS=y
# CONFIG_PINCTRL_INGENIC is not set
# CONFIG_PINCTRL_OCELOT is not set
CONFIG_PINCTRL_ASPEED_PILOT=y
# CONFIG_PINCTRL_UNIPHIER is not set
CONFIG_GPIOLIB=y
CONFIG_GPIO_SYSFS=y
CONFIG_GPIO_PILOT=y
CONFIG_SENSORS_ASPEED_PILOT=y
CONFIG_SENSORS_IIO_HWMON=y
CONFIG_SENSORS_PECI_CPUTEMP=y
CONFIG_SENSORS_PECI_DIMMTEMP=y
CONFIG_WATCHDOG=y
CONFIG_WATCHDOG_CORE=y
CONFIG_PILOT_WDT=y
# CONFIG_SIRFSOC_WATCHDOG is not set
# CONFIG_ABX500_CORE is not set
# CONFIG_HID is not set
# CONFIG_USB_SUPPORT is not set
# CONFIG_VIRTIO_MENU is not set
# CONFIG_COMMON_CLK_XGENE is not set
CONFIG_ARM_GLOBAL_TIMER=y
# CONFIG_IOMMU_SUPPORT is not set
CONFIG_PILOT_ESPI_VW=y
CONFIG_PILOT_ESPI_OOB=y
CONFIG_PILOT_ESPI_MAFS=y
CONFIG_IIO=y
CONFIG_IIO_SW_DEVICE=y
CONFIG_PILOT_ADC=y
CONFIG_PECI=y
CONFIG_PECI_PILOT=y
CONFIG_FANOTIFY=y
CONFIG_QUOTA=y
# CONFIG_PRINT_QUOTA_WARNING is not set
CONFIG_AUTOFS4_FS=y
CONFIG_OVERLAY_FS=y
# CONFIG_OVERLAY_FS_REDIRECT_ALWAYS_FOLLOW is not set
CONFIG_OVERLAY_FS_INDEX=y
CONFIG_OVERLAY_FS_XINO_AUTO=y
CONFIG_PROC_CHILDREN=y
CONFIG_TMPFS=y
CONFIG_TMPFS_POSIX_ACL=y
CONFIG_JFFS2_FS=y
# CONFIG_JFFS2_FS_WRITEBUFFER is not set
CONFIG_JFFS2_FS_XATTR=y
CONFIG_JFFS2_COMPRESSION_OPTIONS=y
CONFIG_JFFS2_LZO=y
CONFIG_JFFS2_RUBIN=y
CONFIG_SQUASHFS=y
CONFIG_SQUASHFS_XATTR=y
CONFIG_SQUASHFS_LZ4=y
CONFIG_SQUASHFS_LZO=y
CONFIG_SQUASHFS_XZ=y
CONFIG_SQUASHFS_ZSTD=y
CONFIG_SQUASHFS_EMBEDDED=y
CONFIG_NFS_FS=y
CONFIG_NLS=y
CONFIG_NLS_DEFAULT="utf8"
CONFIG_NLS_CODEPAGE_437=y
CONFIG_CRYPTO_RSA=y
# CONFIG_CRYPTO_MANAGER_DISABLE_TESTS is not set
# CONFIG_CRYPTO_ECHAINIV is not set
CONFIG_CRYPTO_CRC32=y
CONFIG_CRYPTO_CRCT10DIF=y
CONFIG_CRYPTO_SHA256=y
CONFIG_CRYPTO_SHA512=y
CONFIG_CRYPTO_LZ4=y
CONFIG_CRYPTO_LZ4HC=y
CONFIG_CRYPTO_ANSI_CPRNG=y
# CONFIG_CRYPTO_HW is not set
CONFIG_CRC16=y
CONFIG_LIBCRC32C=y
# CONFIG_XZ_DEC_X86 is not set
# CONFIG_XZ_DEC_POWERPC is not set
# CONFIG_XZ_DEC_IA64 is not set
# CONFIG_XZ_DEC_ARM is not set
# CONFIG_XZ_DEC_ARMTHUMB is not set
# CONFIG_XZ_DEC_SPARC is not set
# CONFIG_ENABLE_MUST_CHECK is not set
CONFIG_UNUSED_SYMBOLS=y
CONFIG_DEBUG_FS=y
CONFIG_DETECT_HUNG_TASK=y
# CONFIG_SCHED_DEBUG is not set
CONFIG_STACKTRACE=y
# CONFIG_DEBUG_BUGVERBOSE is not set
# CONFIG_RCU_TRACE is not set
# CONFIG_FTRACE is not set
# CONFIG_RUNTIME_TESTING_MENU is not set
CONFIG_BUG_ON_DATA_CORRUPTION=y
CONFIG_DEBUG_LL=y
CONFIG_DEBUG_LL_UART_8250=y
CONFIG_DEBUG_UART_PHYS=0x40430000
CONFIG_DEBUG_UART_VIRT=0xF0430000
CONFIG_DEBUG_UART_8250_WORD=y
CONFIG_EARLY_PRINTK=y
```

## meta-evb/meta-evb-aspeed/meta-evb-ast2600/conf/layer.conf
```bitbake
# We have a conf and classes directory, add to BBPATH
BBPATH .= ":${LAYERDIR}"

BBFILE_COLLECTIONS += "evb-ast2600"
BBFILE_PATTERN_evb-ast2600 = ""
```

## meta-evb/meta-evb-aspeed/meta-evb-ast2600/conf/machine/evb-ast2600.conf
```bitbake
FLASH_SIZE = "32768"

#require conf/machine/include/ast2600.inc
require conf/machine/include/obmc-bsp-common.inc
```
