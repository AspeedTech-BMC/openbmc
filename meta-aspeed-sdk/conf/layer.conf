## meta-aspeed-sdk/conf/layer.conf
```bitbake
# We have a conf and classes directory, add to BBPATH
BBPATH .= ":${LAYERDIR}"

BBFILES += "${LAYERDIR}/recipes-*/*/*.bb \
            ${LAYERDIR}/recipes-*/*/*.bbappend"

BBFILE_COLLECTIONS += "aspeed-sdk-layer"
BBFILE_PATTERN_aspeed-sdk-layer := "^${LAYERDIR}/"
LAYERVERSION_aspeed-sdk-layer = "1"
LAYERSERIES_COMPAT_aspeed-sdk-layer = "wrynose whinlatter"

# Provide a variable that points the base of the aspeed-sdk layer.
ASPEEDSDKBASE = '${@os.path.normpath("${LAYERDIR}/")}'

BBFILES_DYNAMIC += " \
    meta-arm:${LAYERDIR}/dynamic-layers/arm-layer/recipes-*/*/*.bb \
    meta-arm:${LAYERDIR}/dynamic-layers/arm-layer/recipes-*/*/*.bbappend \
    zephyrcore:${LAYERDIR}/dynamic-layers/zephyrcore-layer/recipes-*/*/*.bb \
    zephyrcore:${LAYERDIR}/dynamic-layers/zephyrcore-layer/recipes-*/*/*.bbappend \
"
```

## meta-aspeed-sdk/conf/machine/include/ast-ibexfw.inc
```bitbake
MACHINE_FEATURES:append = " ast-ibexfw"
MACHINEOVERRIDES .= ":ast-ibexfw"
UBOOT_FIT_CONF_FIRMWARE = "ibexfw"
```

## meta-aspeed-sdk/conf/machine/include/ast-tsp.inc
```bitbake
MACHINE_FEATURES:append = " ast-tsp"
MACHINEOVERRIDES .= ":ast-tsp"
UBOOT_FIT_CONF_USER_LOADABLES:append = ' ,\"tspfw\"'
```

## meta-aspeed-sdk/conf/machine/include/ast-update-verify.inc
```bitbake
MACHINE_FEATURES:append = " ast-update-verify"
MACHINEOVERRIDES .= ":ast-update-verify"
```

## meta-aspeed-sdk/conf/machine/include/ast2500-sdk.inc
```bitbake
SOC_FAMILY = "aspeed-g5"
include conf/machine/include/soc-family.inc
require conf/machine/include/aspeed-sdk.inc

SERIAL_CONSOLES ?= "115200;ttyS4"

DEFAULTTUNE = "arm1176jzs"
UBOOT_ENTRYPOINT ?= "0x80000000"
UBOOT_LOADADDRESS ?= "0x80000000"

require conf/machine/include/arm/armv6/tune-arm1176jz-s.inc

PREFERRED_VERSION_u-boot-aspeed-sdk = "v2019.04+%"
PREFERRED_VERSION_u-boot-fw-utils-aspeed-sdk = "v2019.04+%"

QB_SYSTEM_NAME = "qemu-system-arm"
QB_MACHINE = "-machine ast2500-evb"
QB_MEM = "-m 1G"
```

## meta-aspeed-sdk/conf/machine/include/ast2600-sdk.inc
```bitbake
SOC_FAMILY = "aspeed-g6"
include conf/machine/include/soc-family.inc
require conf/machine/include/aspeed-sdk.inc

SERIAL_CONSOLES ?= "115200;ttyS4"

DEFAULTTUNE = "armv7ahf-vfpv4d16"
UBOOT_ENTRYPOINT ?= "0x80000000"
UBOOT_LOADADDRESS ?= "0x80000000"
UBOOT_FIT_TEE_LOADADDRESS ?= "0xb0000000"
UBOOT_FIT_TEE_ENTRYPOINT ?= "0xb0000000"

include conf/machine/include/arm/arch-armv7a.inc

COMPATIBLE_MACHINE:aspeed-g6 = "aspeed-g6"
# It is a shortcut for "make PLATFORM=aspeed PLATFORM_FLAVOR=ast2600"
OPTEEMACHINE = "aspeed-ast2600"

UBOOT_FIT_TEE_IMAGE ?= "${DEPLOY_DIR_IMAGE}/optee/tee-raw.bin"

PREFERRED_VERSION_u-boot-aspeed-sdk = "v2019.04+%"
PREFERRED_VERSION_u-boot-fw-utils-aspeed-sdk = "v2019.04+%"
PREFERRED_RPROVIDER_virtual/ssp ?= "ssp"
```

## meta-aspeed-sdk/conf/machine/include/ast2700-sdk.inc
```bitbake
SOC_FAMILY = "aspeed-g7"
include conf/machine/include/soc-family.inc
require conf/machine/include/aspeed-sdk.inc

DEFAULTTUNE = "cortexa35"

require conf/machine/include/arm/armv8a/tune-cortexa35.inc
require conf/machine/include/ast-arm-trusted-firmware-a.inc
require conf/machine/include/ast-bootmcu.inc
require conf/machine/include/ast-optee-os.inc

SERIAL_CONSOLES ?= "115200;ttyS12"

# bootloader fitimage
UBOOT_FIT_UBOOT_ENTRYPOINT ?= "0x80000000"
UBOOT_FIT_UBOOT_LOADADDRESS ?= "0x80000000"
UBOOT_FIT_ARM_TRUSTED_FIRMWARE_LOADADDRESS ?= "0xb0000000"
UBOOT_FIT_ARM_TRUSTED_FIRMWARE_ENTRYPOINT ?= "0xb0000000"
UBOOT_FIT_TEE_LOADADDRESS ?= "0xb0080000"
UBOOT_FIT_TEE_ENTRYPOINT ?= "0xb0080000"
UBOOT_FIT_SSP_ARCH ?= "arm"
UBOOT_FIT_SSP_OS ?= "zephyr"
UBOOT_FIT_SSP_LOADADDRESS ?= "0xac000000"
UBOOT_FIT_SSP_ENTRYPOINT ?= "0xac000000"
UBOOT_FIT_TSP_ARCH ?= "arm"
UBOOT_FIT_TSP_OS ?= "zephyr"
UBOOT_FIT_TSP_LOADADDRESS ?= "0xae000000"
UBOOT_FIT_TSP_ENTRYPOINT ?= "0xae000000"
UBOOT_FIT_IBEXFW_ARCH ?= "riscv"
UBOOT_FIT_IBEXFW_OS ?= "zephyr"
UBOOT_FIT_IBEXFW_LOADADDRESS ?= "0x14ba8000"
UBOOT_FIT_IBEXFW_ENTRYPOINT ?= "0x14ba8000"

# kernel fitimage
# Use lzma compressed algorithm instead of gzip to save the code size.
FIT_KERNEL_COMP_ALG ?= "lzma"
FIT_KERNEL_COMP_ALG_EXTENSION ?= ".lzma"

FIT_ADDRESS_CELLS ?= "2"
UBOOT_ENTRYPOINT ?= "0x4 0x00000000"
UBOOT_LOADADDRESS ?= "0x4 0x00000000"

COMPATIBLE_MACHINE:aspeed-g7 = "aspeed-g7"
TFA_PLATFORM = "ast2700"

# optee for BL32.
TFA_SPD = "opteed"

# TFA default build is BL31.
TFA_BUILD_TARGET = "bl31"

# It is a shortcut for "make PLATFORM=aspeed PLATFORM_FLAVOR=ast2700"
OPTEEMACHINE = "aspeed-ast2700"

UBOOT_FIT_ARM_TRUSTED_FIRMWARE_IMAGE ?= "${DEPLOY_DIR_IMAGE}/${TFA_BUILD_TARGET}.bin"
UBOOT_FIT_TEE_IMAGE ?= "${DEPLOY_DIR_IMAGE}/optee/tee-raw.bin"
UBOOT_FIT_SSP_IMAGE ?= "${DEPLOY_DIR_IMAGE}/zephyr-aspeed-ssp.bin"
UBOOT_FIT_TSP_IMAGE ?= "${DEPLOY_DIR_IMAGE}/zephyr-aspeed-tsp.bin"
UBOOT_FIT_IBEXFW_IMAGE ?= "${DEPLOY_DIR_IMAGE}/zephyr-aspeed-ibexfw.bin"

PREFERRED_PROVIDER_virtual/bootmcu ?= "bootmcu-spl"

# zephyr pre-built toolchain
ZEPHYR_TOOLCHAIN_VARIANT = "zephyr"

# zephyr build
PREFERRED_PROVIDER_virtual/ssp ?= "zephyr-aspeed-ssp"
ZEPHYR_BOARD_SSP ?= "ast2700_evb/ast2700/ssp"

PREFERRED_PROVIDER_virtual/tsp ?= "zephyr-aspeed-tsp"
ZEPHYR_BOARD_TSP ?= "ast2700_evb/ast2700/tsp"

PREFERRED_PROVIDER_virtual/ibexfw ?= "zephyr-aspeed-ibexfw"
ZEPHYR_BOARD_IBEXFW ?= "ast2700_evb/ast2700/bootmcu"
```

## meta-aspeed-sdk/conf/machine/include/ast2700a1-cptra-12.inc
```bitbake
MACHINE_FEATURES:append = " ast2700a1-cptra-12"
MACHINEOVERRIDES .= ":ast2700a1-cptra-12"
```

## meta-aspeed-sdk/conf/machine/include/ast2705-sdk.inc
```bitbake
SOC_FAMILY = "aspeed-g7"
include conf/machine/include/soc-family.inc
require conf/machine/include/aspeed-sdk.inc

DEFAULTTUNE = "cortexa35"

require conf/machine/include/arm/armv8a/tune-cortexa35.inc
require conf/machine/include/ast-arm-trusted-firmware-a.inc
require conf/machine/include/ast-optee-os.inc

SERIAL_CONSOLES ?= "115200;ttyS12"

# kernel fitimage
# Use lzma compressed algorithm instead of gzip to save the code size.
FIT_KERNEL_COMP_ALG ?= "lzma"
FIT_KERNEL_COMP_ALG_EXTENSION ?= ".lzma"

COMPATIBLE_MACHINE:aspeed-g7 = "aspeed-g7"
MACHINE_FEATURES:append = " ast27x5"
MACHINEOVERRIDES .= ":ast27x5"

# TFA platform configuration.
TFA_PLATFORM = "ast2700"
# optee for BL32.
TFA_SPD = "opteed"
# TFA default build is BL31.
TFA_BUILD_TARGET = "bl31"

# It is a shortcut for "make PLATFORM=aspeed PLATFORM_FLAVOR=ast2700"
OPTEEMACHINE = "aspeed-ast2700"

UBOOT_FIT_ARM_TRUSTED_FIRMWARE_IMAGE ?= "${DEPLOY_DIR_IMAGE}/trusted-firmware-a/${TFA_BUILD_TARGET}.bin"
UBOOT_FIT_TEE_IMAGE ?= "${DEPLOY_DIR_IMAGE}/optee/tee-raw.bin"
UBOOT_FIT_SSP_IMAGE ?= "${DEPLOY_DIR_IMAGE}/zephyr-aspeed-ssp.bin"
UBOOT_FIT_TSP_IMAGE ?= "${DEPLOY_DIR_IMAGE}/zephyr-aspeed-tsp.bin"

# zephyr pre-built toolchain
ZEPHYR_TOOLCHAIN_VARIANT = "zephyr"

# zephyr build
PREFERRED_PROVIDER_virtual/ssp ??= "zephyr-aspeed-ssp"
PREFERRED_PROVIDER_virtual/tsp ??= "zephyr-aspeed-tsp"
PREFERRED_VERSION_zephyr-sdk-native = "0.16.9"
PREFERRED_VERSION_zephyr-kernel ??= "3.7.0"

# caliptra manifest
CPTRA_TOML_FILENAME ?= "ast2705-manifest.toml"
CALIPTRA_MANIFEST_CONFIG_DIR ??= "${DEPLOY_DIR_IMAGE}"
CALIPTRA_MANIFEST_CONFIG ??= "${CPTRA_TOML_FILENAME}"
CALIPTRA_MANIFEST_KEY_DIR ??= "${STAGING_DATADIR_NATIVE}/aspeed-secure-config/ast2755/keys"
CALIPTRA_MANIFEST_FLASH_IMAGE ?= "ast2705-manifest-flash.bin"
CALIPTRA_MANIFEST_SOC_IMAGE ?= "ast2705-soc-manifest.bin"

PREFERRED_VERSION_cptra-imgtool = "2x"
PREFERRED_VERSION_cptra-imgtool-native = "2x"
PREFERRED_VERSION_caliptra-mcu-sw-native = "2x"
PREFERRED_VERSION_aspeed-image-manifest = "2x"
PREFERRED_VERSION_aspeed-manifest-config = "2x"
```

## meta-aspeed-sdk/meta-ast2500-sdk/conf/machine/ast2500-default-515.conf
```bitbake
require conf/machine/ast2500-default.conf

# Kernel Build Settings
KERNEL_DEVICETREE = "aspeed-ast2500-evb.dtb"

PREFERRED_VERSION_linux-aspeed = "5.15+%"
```

## meta-aspeed-sdk/meta-ast2500-sdk/conf/machine/ast2500-default-66.conf
```bitbake
require conf/machine/ast2500-default.conf

PREFERRED_VERSION_linux-aspeed = "6.6+%"
```

## meta-aspeed-sdk/meta-ast2600-pfr/conf/machine/ast2600-dcscm-amd.conf
```bitbake
require conf/machine/include/ast2600-sdk.inc
require conf/machine/include/ast-ssp.inc
require conf/machine/include/obmc-bsp-common.inc

# Overwrite flash layout
FLASH_SIZE = "63360"
FLASH_UBOOT_SPL_SIZE = "64"
FLASH_UBOOT_OFFSET = "0"
FLASH_UBOOT_ENV_OFFSET = "1280"
FLASH_KERNEL_OFFSET = "1408"
FLASH_ROFS_OFFSET = "9600"
FLASH_RWFS_OFFSET = "47104"

# PFR settings
PFR_IMAGE_SIZE = "262144"
# 0x03DE0000
PFM_OFFSET_PAGE = "63360"
# 0x04000000
RC_IMAGE_PAGE = "65536"

# U-Boot Build Settings
UBOOT_MACHINE = "ast2600-dcscm_defconfig"
UBOOT_DEVICETREE = "ast2600-dcscm"
SPL_BINARY = "spl/u-boot-spl.bin"
UBOOT_FITIMAGE_ENABLE = "1"

# Kernel Build Settings
KERNEL_DEVICETREE = "aspeed/aspeed-ast2600-dcscm-amd.dtb"
KBUILD_DEFCONFIG = "aspeed_g6_defconfig"

MACHINE_FEATURES += "\
        obmc-phosphor-fan-mgmt \
        obmc-phosphor-chassis-mgmt \
        obmc-phosphor-flash-mgmt \
        obmc-host-ipmi \
        obmc-host-state-mgmt \
        obmc-chassis-state-mgmt \
        obmc-bmc-state-mgmt \
        "

PREFERRED_PROVIDER_virtual/obmc-system-mgmt = "packagegroup-aspeed-obmc"
PREFERRED_PROVIDER_virtual/obmc-host-ipmi-hw = "phosphor-ipmi-kcs"
VIRTUAL-RUNTIME_obmc-host-state-manager ?= "x86-power-control"
VIRTUAL-RUNTIME_obmc-chassis-state-manager ?= "x86-power-control"

EXTRA_IMAGEDEPENDS:append = " \
    aspeed-image-recoveryuart \
    "

PREFERRED_VERSION_linux-aspeed = "6.6+%"
```

## meta-aspeed-sdk/meta-ast2600-pfr/conf/machine/ast2600-dcscm.conf
```bitbake
require conf/machine/include/ast2600-sdk.inc
require conf/machine/include/ast-ssp.inc
require conf/machine/include/obmc-bsp-common.inc
require conf/machine/include/intel-pfr.inc

# Overwrite flash layout
FLASH_SIZE = "65536"
FLASH_UBOOT_SPL_SIZE = "64"
FLASH_UBOOT_OFFSET:flash-65536 = "0"
FLASH_KERNEL_OFFSET:flash-65536 = "1408"
FLASH_ROFS_OFFSET:flash-65536 = "9600"
FLASH_RWFS_OFFSET:flash-65536 = "47104"

# PFR settings
PFR_IMAGE_SIZE = "262144"
# 0x04000000
PFM_OFFSET_PAGE = "65536"
# 0x04220000
RC_IMAGE_PAGE = "67712"
PFR_MANIFEST = "pfr_manifest_ast2600_dcscm.json"
# 1 = SHA256
# 2 = SHA384
# 3 = LMS384
# 4 = LMS256
PFR_SHA = "2"

# U-Boot Build Settings
UBOOT_MACHINE = "ast2600-dcscm_defconfig"
UBOOT_DEVICETREE = "ast2600-dcscm"
SPL_BINARY = "spl/u-boot-spl.bin"
UBOOT_FITIMAGE_ENABLE = "1"

# Kernel Build Settings
KERNEL_DEVICETREE = " \
        aspeed/aspeed-ast2600-dcscm.dtb \
        aspeed/aspeed-ast2600-dcscm-mctp-socket.dtb \
        "

KBUILD_DEFCONFIG = "aspeed_g6_defconfig"

MACHINE_FEATURES += "\
        obmc-phosphor-fan-mgmt \
        obmc-phosphor-chassis-mgmt \
        obmc-phosphor-flash-mgmt \
        obmc-host-ipmi \
        obmc-host-state-mgmt \
        obmc-chassis-state-mgmt \
        obmc-bmc-state-mgmt \
        "

PREFERRED_PROVIDER_virtual/obmc-system-mgmt = "packagegroup-aspeed-obmc"
PREFERRED_PROVIDER_virtual/obmc-host-ipmi-hw = "phosphor-ipmi-kcs"
VIRTUAL-RUNTIME_obmc-host-state-manager ?= "x86-power-control"
VIRTUAL-RUNTIME_obmc-chassis-state-manager ?= "x86-power-control"

EXTRA_IMAGEDEPENDS:append = " \
    aspeed-image-recoveryuart \
    "
```

## meta-aspeed-sdk/meta-ast2600-sdk/conf/machine/ast2600-default-66.conf
```bitbake
require conf/machine/ast2600-default.conf

PREFERRED_VERSION_linux-aspeed = "6.6+%"
```

## meta-aspeed-sdk/meta-ast2600-sdk/conf/machine/ast2600-default-ncsi.conf
```bitbake
require conf/machine/ast2600-default.conf

# U-Boot Build Settings
UBOOT_DEVICETREE = "ast2600-ncsi"

# Kernel Build Settings
KERNEL_DEVICETREE = "aspeed/aspeed-ast2600-ncsi.dtb"

PREFERRED_VERSION_linux-aspeed = "6.6+%"
```
