## meta-zephyr/meta-zephyr-bsp/conf/machine/nrf52840-mdk-usb-dongle.conf
```bitbake
#@TYPE: Machine
#@NAME: nrf52840-mdk-usb-dongle

#@DESCRIPTION: Machine configuration for makerdiary's nrf52840-mdk-usb-dongle

require conf/machine/include/nrf52.inc
```

## meta-zephyr/meta-zephyr-bsp/conf/machine/nrf52840dk-nrf52840.conf
```bitbake
#@TYPE: Machine
#@NAME: nrf52840dk-nrf52840

#@DESCRIPTION: Machine configuration for Nordic Semiconductor nRF52840 Development Kit.

require conf/machine/include/nrf52.inc
ZEPHYR_INHERIT_CLASSES += "zephyr-flash-pyocd"
```

## meta-zephyr/meta-zephyr-bsp/conf/machine/qemu-cortex-a9.conf
```bitbake
#@TYPE: Machine
#@NAME: qemu-cortex-a9
#@DESCRIPTION: Machine for Zephyr BOARD qemu_cortex_a9

DEFAULTTUNE ?= "cortexa9"
require conf/machine/include/qemu.inc
require conf/machine/include/arm/armv7a/tune-cortexa9.inc

TCLIBC = "newlib"

# For runqemu
QB_SYSTEM_NAME = "qemu-system-arm"
QB_MACHINE = "-machine xilinx-zynq-a9"
QB_CPU = "-cpu cortex-a9"
QB_GRAPHICS = "-nographic -vga none"
QB_OPT_APPEND = "-icount shift=3,align=off,sleep=off -rtc clock=vm"

# Zephyr RTOS settings
ZEPHYR_INHERIT_CLASSES += "zephyr-qemuboot"
```

## meta-zephyr/meta-zephyr-bsp/conf/machine/qemu-cortex-m0.conf
```bitbake
#@TYPE: Machine
#@NAME: qemu-cortex-m0
#@DESCRIPTION: Machine for BBC Microbit v1, Zephyr BOARD qemu_cortex_m0

require conf/machine/include/qemu.inc
require conf/machine/include/arm/armv6m/tune-cortexm0.inc

MACHINEOVERRIDES =. "nordic:"

# GLIBC will not work with Cortex-M.
TCLIBC = "newlib"

# For runqemu
QB_SYSTEM_NAME = "qemu-system-arm"
QB_MACHINE = "-machine microbit"
QB_CPU = "-cpu cortex-m0"
QB_GRAPHICS = "-nographic -vga none"
QB_RNG = ""
QB_OPT_APPEND = "-icount shift=6,align=off,sleep=off -rtc clock=vm"

# Zephyr RTOS settings
ZEPHYR_BOARD = "qemu_cortex_m0"
ZEPHYR_INHERIT_CLASSES += "zephyr-qemuboot"
```

## meta-zephyr/meta-zephyr-bsp/conf/machine/qemu-cortex-m3.conf
```bitbake
#@TYPE: Machine
#@NAME: qemu-cortex-m3
#@DESCRIPTION: Machine for Zephyr BOARD qemu_cortex_m3

require conf/machine/include/qemu.inc
require conf/machine/include/arm/armv7m/tune-cortexm3.inc

ZEPHYR_INHERIT_CLASSES += "zephyr-qemuboot"

# For runqemu
QB_SYSTEM_NAME = "qemu-system-arm"
QB_MACHINE = "-machine lm3s6965evb"
QB_GRAPHICS = "-nographic -vga none"
QB_CPU = "-cpu cortex-m3"
QB_RNG = ""
QB_OPT_APPEND = "-icount shift=6,align=off,sleep=off -rtc clock=vm"
```

## meta-zephyr/meta-zephyr-bsp/conf/machine/qemu-nios2.conf
```bitbake
#@TYPE: Machine
#@NAME: qemu-nios2
#@DESCRIPTION: Machine for Zephyr BOARD qemu_nios2

require conf/machine/include/qemu.inc
require conf/machine/include/tune-nios2.inc

ZEPHYR_INHERIT_CLASSES += "zephyr-qemuboot"

# For runqemu
QB_SYSTEM_NAME = "qemu-system-nios2"
QB_MACHINE = "-machine altera_10m50_zephyr"
QB_OPT_APPEND = "-nographic"
QB_CPU = "-cpu nios2"


TCLIBC = "glibc"
```

## meta-zephyr/meta-zephyr-bsp/conf/machine/qemu-x86.conf
```bitbake
#@TYPE: Machine
#@NAME: qemu-x86
#@DESCRIPTION: Machine for Zephyr BOARD qemu_x86

require conf/machine/include/qemu.inc
require conf/machine/include/x86/tune-i586.inc

ZEPHYR_INHERIT_CLASSES += "zephyr-qemuboot"

# For runqemu
QB_SYSTEM_NAME = "qemu-system-i386"
QB_MACHINE = "-machine type=pc-q35-2.10"
QB_GRAPHICS = "-nographic -machine acpi=off"
QB_CPU:x86 = "-cpu qemu32,+nx,+pae"
QB_CPU_KVM:x86 = "-cpu kvm32"
```

## meta-zephyr/meta-zephyr-bsp/conf/machine/stm32mp157c-dk2.conf
```bitbake
#@TYPE: Machine
#@NAME: stm32mp1-openamp

#@DESCRIPTION: Machine configuration for stm32mp157x-DK2 Board.

require conf/machine/include/stm32mp1-cortex-m4.inc
```

## meta-zephyr/meta-zephyr-bsp/conf/machine/v2m-beetle.conf
```bitbake
# Configuration for Beetle development board

#@TYPE: Machine
#@NAME: Beetle machine
#@DESCRIPTION: Machine configuration for Beetle

require conf/machine/include/arm/armv7m/tune-cortexm3.inc

# GLIBC will not work with Cortex-M.
TCLIBC = "newlib"
```

## meta-zephyr/meta-zephyr-bsp/conf/machine/xenvm.conf
```bitbake
#@TYPE: Machine
#@NAME: xenvm
#@DESCRIPTION: Machine for Zephyr BOARD xenvm(gicv2) that allows
#              to run Zephyr as Xen guest on any ARMv8 board that
#              supports ARM Virtualization Extensions.

# Include tune-cortexa72-cortexa53.inc
require conf/machine/include/arm/armv8a/tune-cortexa72-cortexa53.inc

DEFAULTTUNE = "cortexa72-cortexa53"

# Zephyr RTOS settings
ZEPHYR_BOARD = "xenvm"
ARCH:xenvm = "aarch64"
```

## meta-zephyr/meta-zephyr-bsp/conf/machine/xenvmgicv3.conf
```bitbake
#@TYPE: Machine
#@NAME: xenvmgicv3
#@DESCRIPTION: Machine for Zephyr BOARD xenvm gicv3 variant that
#              to allows run Zephyr as Xen guest on any ARMv8 board
#              that supports ARM Virtualization Extensions.

# Include tune-cortexa72-cortexa53.inc
require conf/machine/include/arm/armv8a/tune-cortexa72-cortexa53.inc

DEFAULTTUNE = "cortexa72-cortexa53"

# Zephyr RTOS settings
ZEPHYR_BOARD = "xenvm/xenvm/gicv3"
ARCH:xenvm = "aarch64"
```

## meta-zephyr/meta-zephyr-core/conf/layer.conf
```bitbake
# We have a conf and classes directory, add to BBPATH
BBPATH .= ":${LAYERDIR}"

# We have recipes-* directories, add to BBFILES
BBFILES += "${LAYERDIR}/recipes-*/*/*.bb \
	${LAYERDIR}/recipes-*/*/*.bbappend"

BBFILE_COLLECTIONS += "zephyrcore"
BBFILE_PATTERN_zephyrcore = "^${LAYERDIR}/"
BBFILE_PRIORITY_zephyrcore = "6"

# This should only be incremented on significant changes that will
# cause compatibility issues with other layers
LAYERVERSION_zephyrcore = "1"

LAYERDEPENDS_zephyrcore = "core meta-python"

LAYERSERIES_COMPAT_zephyrcore = "scarthgap styhead"

PYTHON3_NATIVE_SITEPACKAGES_DIR = "${libdir_native}/${PYTHON3_DIR}/site-packages"

addpylib ${LAYERDIR}/lib oeqa
```
